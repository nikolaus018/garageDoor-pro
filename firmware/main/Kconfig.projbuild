## firmware/main/Kconfig.projbuild
```kconfig
menu "garageDoor"

    choice GARAGE_BOARD
        prompt "Board"
        default GARAGE_BOARD_S3_DEVKIT if IDF_TARGET_ESP32S3
        default GARAGE_BOARD_C3_SUPERMINI
        help
            Pin map to build for. See board.h and docs/prototype-build.md.

        config GARAGE_BOARD_C3_SUPERMINI
            bool "ESP32-C3 SuperMini on perfboard"
            depends on IDF_TARGET_ESP32C3
        config GARAGE_BOARD_S3_DEVKIT
            bool "ESP32-S3 DevKitC on perfboard"
            depends on IDF_TARGET_ESP32S3
        config GARAGE_BOARD_PCB_V1
            bool "garageDoor-pro PCB v1.0 (ESP32-C3-MINI-1)"
            depends on IDF_TARGET_ESP32C3
    endchoice

endmenu
```

## firmware/sdkconfig.defaults.pcb-v1
```kconfig
# Build for the garageDoor-pro PCB:
#   idf.py -D SDKCONFIG_DEFAULTS="sdkconfig.defaults;sdkconfig.defaults.pcb-v1" build
CONFIG_GARAGE_BOARD_PCB_V1=y
```
